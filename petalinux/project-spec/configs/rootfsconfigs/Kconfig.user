## petalinux/project-spec/configs/rootfsconfigs/Kconfig.user
```kconfig
menu "user packages " 
config axi-gpio-drv  
	 bool "axi-gpio-drv"
	 help
	
config axil-regfile  
	 bool "axil-regfile"
	 help
	
config gpio-demo  
	 bool "gpio-demo"
	 help
	
config peekpoke  
	 bool "peekpoke"
	 help
	
config vdma-capture  
	 bool "vdma-capture"
	 help
	
endmenu
```
